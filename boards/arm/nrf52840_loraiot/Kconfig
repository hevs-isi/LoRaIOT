## boards/arm/nrf52840_loraiot/Kconfig.board
```kconfig
# Kconfig - nRF52840 LoRaIoT board configuration
#
# SPDX-License-Identifier: Apache-2.0

config  BOARD_NRF52840_LORAIOT
	bool "NRF52840 LORAIOT"
	select HAS_DTS_I2C
    select HAS_DTS_I2C_DEVICE
    select HAS_NORDIC_DRIVERS
    # TODO: find why LPCOMP can be selected only here
    select NRFX_LPCOMP
	depends on SOC_NRF52840_QIAA
```

## boards/arm/nrf52840_loraiot/Kconfig.defconfig
```kconfig
# Kconfig - nRF52 LoRaIoT board configuration
#
# SPDX-License-Identifier: Apache-2.0

if BOARD_NRF52840_LORAIOT

config BOARD
	default nrf52840_loraiot

if GPIO_NRF5

config GPIO_NRF5_P0
	default y
	
config GPIO_NRF5_P1
    default y

endif # GPIO_NRF5

if UART_NRF5

config UART_NRF5_GPIO_TX_PIN
	default 28

config UART_NRF5_GPIO_RX_PIN
	default 47

endif # UART_NRF5

config I2C
    def_bool y

if I2C

config I2C_NRF5
    def_bool y

if I2C_NRF5

config I2C_0
    def_bool y

endif #I2C_NRF5

if I2C_0

config I2C_NRF5_0_GPIO_SDA_PIN
    default 8

config I2C_NRF5_0_GPIO_SCL_PIN
    default 7

endif # I2C_0

endif # I2C




if USB

config USB_NRF52840
	def_bool y

config USB_DEVICE_STACK
	def_bool y

endif # USB

endif # BOARD_NRF52840_LORAIOT
```

## boards/arm/nrf52840_loraiot/nrf52840_loraiot_defconfig
```kconfig
CONFIG_ARM=y
CONFIG_SOC_FAMILY_NRF=y
CONFIG_SOC_SERIES_NRF52X=y
CONFIG_SOC_NRF52840_QIAA=y
CONFIG_BOARD_NRF52840_LORAIOT=y

# Enable MPU
CONFIG_ARM_MPU_NRF52X=y

# enable uart driver
CONFIG_SERIAL=y
CONFIG_UART_NRF5=y

# enable console
CONFIG_CONSOLE=y


# additional board options
CONFIG_GPIO_AS_PINRESET=y

CONFIG_I2C=y
CONFIG_I2C_NRF5=y
CONFIG_I2C_SWITCH=y
CONFIG_SENSOR=y
#CONFIG_TEMP_NRF5=y
CONFIG_SHTC1=y
CONFIG_OPT3002=y
CONFIG_CCS811=y
CONFIG_PYD1588=y
CONFIG_PYD1588_DL_GPIO_DEV_NAME="GPIO_0"
CONFIG_PYD1588_DL_GPIO_PIN_NUM=20
CONFIG_PYD1588_SERIN_GPIO_DEV_NAME="GPIO_0"
CONFIG_PYD1588_SERIN_GPIO_PIN_NUM=17

CONFIG_COMP=y
CONFIG_LPCOMP_NRF5=y
CONFIG_ANALOGMIC=y
CONFIG_ANALOGMIC_OUT_GPIO_PIN_NUM=5
```

## drivers/comp/Kconfig
```kconfig
# Kconfig - COMP configuration options

#
# Copyright (c) 2015 Intel Corporation
#
# SPDX-License-Identifier: Apache-2.0
#

menuconfig COMP
	bool
	prompt "Comparator Drivers"
	default n
	help
	  Include Comparator drivers in system config

if COMP

config SYS_LOG_COMP_LEVEL
	int
	prompt "Comparator drivers log level"
	default 0
	depends on SYS_LOG
	help
	  Sets log level for COMP drivers

	  Levels are:

	  - 0 OFF, do not write

	  - 1 ERROR, only write SYS_LOG_ERR

	  - 2 WARNING, write SYS_LOG_WRN in addition to previous level

	  - 3 INFO, write SYS_LOG_INF in addition to previous levels

	  - 4 DEBUG, write SYS_LOG_DBG in addition to previous levels

source "drivers/comp/Kconfig.nrf5"

endif # COMP
```

## drivers/comp/Kconfig.nrf5
```kconfig
# Kconfig.nrf5 - Nordic Semiconductor nRF5x COMP configuration options
#
# Copyright (c) 2016-2018 Nordic Semiconductor ASA
#
# SPDX-License-Identifier: Apache-2.0
#

menuconfig LPCOMP_NRF5
	bool "Nordic Semiconductor nRF5x-based LPCOMP driver"
	depends on COMP && SOC_FAMILY_NRF
	help
	  Enable LPCOMP driver for nRF5.

if LPCOMP_NRF5

config LPCOMP_NRF5_INIT_PRIORITY
	int "nRF5 LPCOMP initialization priority"
	default 40
	help
	  Initialization priority for nRF5 LPCOMP.

config LPCOMP_NRF5_DEV_NAME
	string "Low Power Comparator Device Name"
	depends on LPCOMP_NRF5
	default "LPCOMP"
	help
	  Specify the device name to be used for the Low Power Comparator.
	  
endif # LPCOMP_NRF5
```

## drivers/i2c/Kconfig.switch
```kconfig
menuconfig I2C_SWITCH
    bool
    prompt "I2C switch driver (wrapper)"
    depends on I2C
    default n
    help
      Enable driver for an I2C switch.

config I2C_SWITCH_ADDR
    hex "I2C swtich address"
    depends on I2C_SWITCH
    default "0x74"
    help
      I2C address of the I2C switch.

config I2C_SWITCH_I2C_MASTER_DEV_NAME
    string
    prompt "I2C master where the I2C switch is connected"
    depends on I2C_SWITCH
    default "I2C_0"
    help
      Specify the device name of the I2C master device to which the
      I2C switch chip is connected.
```

## drivers/lora/Kconfig
```kconfig
# Kconfig - LoRa driver configuration options
#
# SPDX-License-Identifier: Apache-2.0
#

menuconfig LORA
    bool "add support for LoRa Drivers"
    default n

if LORA

config SYS_LOG_LORA_LEVEL
    int "LoRa driver log level"
    depends on SYS_LOG
    default 0
    range 0 4
    help
      Sets log level for LoRa Device Drivers.
      Levels are:
      0 OFF, do not write
      1 ERROR, only write SYS_LOG_ERR
      2 WARNING, write SYS_LOG_WRN in addition to previous level
      3 INFO, write SYS_LOG_INF in addition to previous levels
      4 DEBUG, write SYS_LOG_DBG in addition to previous levels

config LORA_INIT_PRIORITY
    int "LoRa driver init priority"
    depends on LORA
    default 80
    help
      WiFi device driver initialization priority.
      Do not mess with it unless you know what you are doing.
      Note that the priority needs to be lower than the net stack
      so that it can start before the networking sub-system.

config LORA_OFFLOAD
    bool "Support offloaded LoRa device drivers"
    default n
    help
      Enable support for Full-MAC LoRa devices.

source "drivers/lora/wimod_im881a/Kconfig.im881a"

endif # WIFI
```

## drivers/lora/wimod_im881a/Kconfig.im881a
```kconfig
# Kconfig - Atmel IM881A WiFi driver options

#
# SPDX-License-Identifier: Apache-2.0
#

menuconfig LORA_IM881A
	bool "IM881A driver support"
	default n
	select SERIAL

if LORA_IM881A

config LORA_IM881A_NAME
	string "Driver name"
	default "IM881A"

config LORA_IM881A_UART_DRV_NAME
	string "UART device where IM881A is connected"
	default "UART_0"
	help
	 Specify the device name of the UART device to which IM881A is
	 connected.

config LORA_IM881A_UART_FREQ
	int "UART baudrate to use with IM881A"
	default 115200
	help
	 UART baudrate to use with IM881A


endif # LORA_IM881A
```

## drivers/sensor/analogmic/Kconfig
```kconfig
# Kconfig - Analog microphone configuration options

#
# Copyright (c) 2016 Intel Corporation
#
# SPDX-License-Identifier: Apache-2.0
#

menuconfig ANALOGMIC
	bool
	prompt "Analog microphone"
	default n
	help
	  Enable driver for analog microphone.

config ANALOGMIC_NAME
	string
	prompt "Driver name"
	default "ANALOGMIC"
	depends on ANALOGMIC
	help
	  Device name with which the analog microphone is identified.
	  

choice
    prompt "Trigger thread"
    depends on ANALOGMIC
    default ANALOGMIC_TRIGGER_OWN_THREAD
    help
      Specify the type of thread to be used by the driver.

config ANALOGMIC_TRIGGER_GLOBAL_THREAD
    bool
    prompt "Use global thread"
    depends on GPIO

config ANALOGMIC_TRIGGER_OWN_THREAD
    bool
    prompt "Use own thread"
    depends on GPIO

endchoice

config ANALOGMIC_OUT_GPIO_DEV_NAME
    string
    prompt "Microphone output GPIO device"
    default "GPIO_0"
    depends on ANALOGMIC
    help
      The device name of the GPIO device to which the output 
      of the microphone is connected.

config ANALOGMIC_OUT_GPIO_PIN_NUM
    int
    prompt "Microphone output GPIO pin number"
    default 0
    depends on ANALOGMIC
    help
      The number of the GPIO on which the output signal from the
      microphone chip will be received.
      
config ANALOGMIC_THREAD_PRIORITY
    int
    prompt "Thread priority"
    depends on ANALOGMIC && ANALOGMIC_TRIGGER_OWN_THREAD
    default 10
    help
      Priority of thread used by the driver to handle interrupts.

config ANALOGMIC_THREAD_STACK_SIZE
    int
    prompt "Thread stack size"
    depends on ANALOGMIC && ANALOGMIC_TRIGGER_OWN_THREAD
    default 1024
    help
      Stack size of thread used by the driver to handle interrupts.
      
    
```

## drivers/sensor/opt3002/Kconfig
```kconfig
# Kconfig - OPT3002 light sensor configuration options
#
# Copyright (c) 2016 Intel Corporation
#
# SPDX-License-Identifier: Apache-2.0
#

menuconfig OPT3002
	bool
	prompt "OPT3002 Light Sensor"
	depends on I2C
	default n
	help
	  Enable driver for OPT3002 light sensor.

config OPT3002_NAME
	string
	prompt "Driver name"
	default "OPT3002"
	depends on OPT3002
	help
	  Device name with which the OPT3002 sensor is identified.

config OPT3002_I2C_ADDR
	hex "OPT3002 I2C address"
	depends on OPT3002
	default "0x44"
	help
	  I2C address of the OPT3002 sensor.

config OPT3002_I2C_MASTER_DEV_NAME
	string
	prompt "I2C master where OPT3002 is connected"
	depends on OPT3002
	default "I2C_0"
	help
	  Specify the device name of the I2C master device to which the
	  OPT3002 chip is connected.
	  
	  
choice
    prompt "Trigger mode"
    depends on OPT3002
    default OPT3002_TRIGGER_NONE
    help
      Specify the type of triggering to be used by the driver.

config OPT3002_TRIGGER_NONE
    bool
    prompt "No trigger"

config OPT3002_TRIGGER_GLOBAL_THREAD
    bool
    prompt "Use global thread"
    depends on GPIO
    select OPT3002_TRIGGER

config OPT3002_TRIGGER_OWN_THREAD
    bool
    prompt "Use own thread"
    depends on GPIO
    select OPT3002_TRIGGER

endchoice

config OPT3002_TRIGGER
    bool
    depends on OPT3002

config OPT3002_GPIO_DEV_NAME
    string
    prompt "GPIO device"
    default "GPIO_0"
    depends on OPT3002 && OPT3002_TRIGGER
    help
      The device name of the GPIO device to which the OPT3002 interrupt
      pins are connected.

config OPT3002_GPIO_PIN_NUM
    int
    prompt "Interrupt GPIO pin number"
    default 0
    depends on OPT3002 && OPT3002_TRIGGER
    help
      The number of the GPIO on which the interrupt signal from the
      OPT3002 chip will be received.

config OPT3002_THREAD_PRIORITY
    int
    prompt "Thread priority"
    depends on OPT3002 && OPT3002_TRIGGER_OWN_THREAD
    default 10
    help
      Priority of thread used by the driver to handle interrupts.

config OPT3002_THREAD_STACK_SIZE
    int
    prompt "Thread stack size"
    depends on OPT3002 && OPT3002_TRIGGER_OWN_THREAD
    default 1024
    help
      Stack size of thread used by the driver to handle interrupts.
	  
	  
```

## drivers/sensor/pac1934/Kconfig
```kconfig
# Kconfig - PAC1934 temperature and humidity sensor configuration options

#
# Copyright (c) 2016 Intel Corporation
#
# SPDX-License-Identifier: Apache-2.0
#

menuconfig PAC1934
	bool
	prompt "PAC1934 Power Monitor"
	depends on I2C
	default n
	help
	  Enable driver for PAC1934 power monitor device.

config PAC1934_NAME
	string
	prompt "Driver name"
	default "PAC1934"
	depends on PAC1934
	help
	  Device name with which the PAC1934 sensor is identified.

config PAC1934_I2C_ADDR
	hex "PAC1934 I2C address"
	depends on PAC1934
	default "0x10"
	help
	  I2C address of the PAC1934 device.

config PAC1934_I2C_MASTER_DEV_NAME
	string
	prompt "I2C master where PAC1934 is connected"
	depends on PAC1934
	default "I2C_0"
	help
	  Specify the device name of the I2C master device to which the
	  PAC1934 chip is connected.
	  
	  
```

## drivers/sensor/pyd1588/Kconfig
```kconfig
# Kconfig - PYD1588 motion sensor configuration options

#
# Copyright (c) 2016 Intel Corporation
#
# SPDX-License-Identifier: Apache-2.0
#

menuconfig PYD1588
	bool
	prompt "PYD1588 Motion Sensor"
	default n
	help
	  Enable driver for PYD1588 PIR sensor.

config PYD1588_NAME
	string
	prompt "Driver name"
	default "PYD1588"
	depends on PYD1588
	help
	  Device name with which the PYD1588 sensor is identified.
	  

choice
    prompt "Trigger thread"
    depends on PYD1588
    default PYD1588_TRIGGER_OWN_THREAD
    help
      Specify the type of thread to be used by the driver.

config PYD1588_TRIGGER_GLOBAL_THREAD
    bool
    prompt "Use global thread"
    depends on GPIO

config PYD1588_TRIGGER_OWN_THREAD
    bool
    prompt "Use own thread"
    depends on GPIO

endchoice

config PYD1588_DL_GPIO_DEV_NAME
    string
    prompt "Direct Link GPIO device"
    default "GPIO_0"
    depends on PYD1588
    help
      The device name of the GPIO device to which the Direct Link 
      pin is connected.

config PYD1588_DL_GPIO_PIN_NUM
    int
    prompt "Direct Link GPIO pin number"
    default 0
    depends on PYD1588
    help
      The number of the GPIO on which the interrupt signal from the
      PYD1588 chip will be received.
      
config PYD1588_SERIN_GPIO_DEV_NAME
    string
    prompt "Serial In GPIO device"
    default "GPIO_0"
    depends on PYD1588
    help
      The device name of the GPIO device to which the Serial In 
      pin is connected.

config PYD1588_SERIN_GPIO_PIN_NUM
    int
    prompt "Serial In GPIO pin number"
    default 1
    depends on PYD1588
    help
      The number of the GPIO on which the Serial In pin is connected.

config PYD1588_THREAD_PRIORITY
    int
    prompt "Thread priority"
    depends on PYD1588 && PYD1588_TRIGGER_OWN_THREAD
    default 10
    help
      Priority of thread used by the driver to handle interrupts.

config PYD1588_THREAD_STACK_SIZE
    int
    prompt "Thread stack size"
    depends on PYD1588 && PYD1588_TRIGGER_OWN_THREAD
    default 1024
    help
      Stack size of thread used by the driver to handle interrupts.
      
    
```

## drivers/sensor/shtc1/Kconfig
```kconfig
# Kconfig - SHTC1 temperature and humidity sensor configuration options

#
# Copyright (c) 2016 Intel Corporation
#
# SPDX-License-Identifier: Apache-2.0
#

menuconfig SHTC1
	bool
	prompt "SHTC1 Temperature and Humidity Sensor"
	depends on I2C
	default n
	help
	  Enable driver for SHTC1 temperature and humidity sensors.

config SHTC1_NAME
	string
	prompt "Driver name"
	default "SHTC1"
	depends on SHTC1
	help
	  Device name with which the SHTC1 sensor is identified.

config SHTC1_I2C_ADDR
	hex "SHTC1 I2C address"
	depends on SHTC1
	default "0x70"
	help
	  I2C address of the SHTC1 sensor.

config SHTC1_I2C_MASTER_DEV_NAME
	string
	prompt "I2C master where SHTC1 is connected"
	depends on SHTC1
	default "I2C_0"
	help
	  Specify the device name of the I2C master device to which the
	  SHTC1 chip is connected.
	  
choice
    prompt "Clock stretching"
    depends on SHTC1
    default SHTC1_CLOCK_STRETCHING_DIS
    help
      Enable I2C clock stretching for the device. 

config SHTC1_CLOCK_STRETCHING_EN
    bool
    prompt "enabled"

config SHTC1_CLOCK_STRETCHING_DIS
    bool
    prompt "disabled"

endchoice

choice
    prompt "First readout measurement"
    depends on SHTC1
    default SHTC1_FIRST_MEASUREMENT_TEMP
    help
      First measurement comming out when reading data. 

config SHTC1_FIRST_MEASUREMENT_TEMP
    bool
    prompt "temperature"

config SHTC1_FIRST_MEASUREMENT_HUM
    bool
    prompt "humidity"

endchoice
```
